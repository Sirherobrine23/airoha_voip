// SPDX-License-Identifier: GPL-2.0
/*
 * Example: EN751221 board with two FXS ports on a single dual-channel
 * Microsemi Le9642, reached over ZSI.
 *
 * Modelled on the TP-Link Archer XR500v, which is the board this path
 * was proven on. Merge the &-references into your own board .dts; the
 * /dts-v1/ line and the SoC include are only here so the file stands
 * alone for reference.
 */

/dts-v1/;

#include "en751221.dtsi"
#include "en751221-voice.dtsi"

/ {
	model = "EN751221 with 2x FXS (Le9642)";
	compatible = "econet,en751221";
};

&pcm0 {
	airoha,dma-channel-mask = <0x03>;
	status = "okay";
};

&zsi0 {
	status = "okay";

	slic0: slic@0 {
		compatible = "microsemi,le9642";
		reg = <0>;

		airoha,zsi = <&zsi0>;
		airoha,pcm = <&pcm0>;
		airoha,lines = <2>;

		/*
		 * PCM *bus* timeslots, not DMA channels. The two are
		 * related only by the engine's timeslot table: with the
		 * default table channel n sits at bit offset 32 + n * 16,
		 * i.e. at bus slot 4 + n * 2, so slots 4 and 6 are DMA
		 * channels 0 and 1. The driver resolves this at probe and
		 * refuses a slot no channel covers, so a mistake here is
		 * a probe failure rather than a silent line.
		 */
		airoha,bus-slots = <4 6>;

		/* 16-bit linear is the default; uncomment for a-law regions */
		/* airoha,a-law; */

		status = "okay";
	};
};
