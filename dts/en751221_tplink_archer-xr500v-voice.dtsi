// SPDX-License-Identifier: GPL-2.0
/*
 * TP-Link Archer XR500v: two RJ11 jacks on a single 2-channel Le9642.
 *
 * The case labels are inverted relative to the silicon, exactly like
 * the ethernet ports: the jack marked "phone2" is SLIC channel 1
 * (EC_1) and "phone1" is channel 2 (EC_2).
 */

&pcm0 {
	status = "okay";
};

&zsi0 {
	status = "okay";
};

&slic0 {
	status = "okay";
	econet,lines = <2>;
	econet,bus-slots = <4 6>;
};
